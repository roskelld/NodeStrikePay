
//includes
#include <ArduinoHttpClient.h>
#include <ESP8266WiFi.h>
#include <ArduinoJson.h>
#include <qrcode.h>
#include <string.h>
#include <GxEPD.h>
#include <GxGDEP015OC1/GxGDEP015OC1.h>  
#include <GxIO/GxIO_SPI/GxIO_SPI.h>
#include <GxIO/GxIO.h>

//Wifi details
char wifiSSID[] = "ENTER_WIFI_SSID_HERE";
char wifiPASS[] = "ENTER_WIFI_PASSWORD_HERE";

//Set Arduino Strings for amount of Sats, description and API key
String invoiceamount = "10";
String invoicedescription = "ENTER_INVOICE_DESCRIPTION_HERE";

String strikeapikey = "ENTER_STRIKE_API_KEY_HERE";

char serverAddress[] = "api.strike.acinq.co";


// Strike Form Sending 
String contentType = "application/x-www-form-urlencoded";
String postData = "?POST&amount=" + invoiceamount + "&currency=btc&description=" + invoicedescription;
StaticJsonBuffer<2000> jsonBuffer;

// Invoice Paid State
bool PAID = false;

// Scaling QR code for screen
// Configured for Waveshare 200x200 1.54inch e-Paper Screen https://www.waveshare.com/wiki/1.54inch_e-Paper_Module
int scale = 3;
int border = (200 - ( 61 * scale )) / 2;


//Define pins for SPI communication with epaper module
GxIO_Class io(SPI, SS, 0, 2);
GxEPD_Class display(io);


//Char byte array of the lightning bolt image used by the waveshare epaper (for more details, https://www.waveshare.com/wiki/1.54inch_e-Paper_Module)
const unsigned char lightningbolt [] = {
  0xff, 0xff, 0xff, 0xff, 0xff, 0xff, 0xff, 0xff, 0xff, 0xff, 0xff, 0xff, 0xff, 0xff, 0xff, 0xff, 
  0xff, 0xff, 0xff, 0xff, 0xff, 0xff, 0xff, 0xff, 0xff, 0xff, 0xff, 0xff, 0xff, 0xff, 0xff, 0xff, 
  0xff, 0xff, 0xff, 0xff, 0xff, 0xff, 0xff, 0xff, 0xff, 0xff, 0xff, 0xff, 0xff, 0xff, 0xff, 0xff, 
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  0xff, 0xff, 0xff, 0xff, 0xff, 0xff, 0xff, 0xff
};

// Setup Wifi
WiFiClient wifi;
HttpClient client = HttpClient(wifi, serverAddress);
int status = WL_IDLE_STATUS;
int statusCode = 0;

//Init
void setup() {
  display.init(115200); 
  Serial.begin(115200);                  
  Serial.println("STARTING SYSTEM\n");
  //connect to local wifi            
  WiFi.begin(wifiSSID, wifiPASS);   
  while (WiFi.status() != WL_CONNECTED) {  
    delay(500);
    Serial.print(".");
  }
  Serial.println();
  Serial.print("Connected, IP address: ");
  Serial.println(WiFi.localIP());
  
  //initialise GPIO D1
  // Used for sending signal when payment detected
  pinMode(D1, OUTPUT);
  
  // Clear Screen and Draw Default Image
  display.drawBitmap(lightningbolt, 0, 0, 200, 200, GxEPD_WHITE); 
  display.update();
  
  //request initial invoice from ACINQ STRIKE  
  requestInvoice();
}


//Main loop
void loop() {
  //Checks to see if the QR has been paid
  if ( PAID == true ){
    Serial.println("SENDING PAID SIGNAL");
    // Send signal 
    digitalWrite(D1, HIGH);
    delay(100);
    digitalWrite(D1, LOW);
    delay(500);
    
    //request invoice from ACINQ STRIKE  
    requestInvoice(); 
  } else {
    Serial.println("Waiting for QR to be paid");
    // Delay between calls to server 
    delay(500);
    checkpay();
  }
}
// END LOOP

// Ping ACINQ STRIKE to see if payment has happened
void checkpay () {
  Serial.println("SENDING PAYMENT CHECK REQUEST");
  client.beginRequest();
  client.get("/api/v1/charges?size=1");
  client.sendBasicAuth(strikeapikey, strikeapikey);   
  client.endRequest();
  JsonObject& root = jsonBuffer.parseObject(client.responseBody().substring(1, client.responseBody().length() -1));
  if ( root["paid"] == "true" ) {
    PAID = true;
  } else {
    PAID = false;
  }
  jsonBuffer.clear();
}

// Request new invoice from ACINQ STRIKE
void requestInvoice() {
  client.beginRequest();
  client.post("/api/v1/charges");
  client.sendHeader("Content-Type", "application/x-www-form-urlencoded");
  client.sendHeader("Content-Length", postData.length());
  client.sendBasicAuth(strikeapikey, strikeapikey); 
  client.beginBody();
  client.print(postData);
  client.endRequest();
  JsonObject& root = jsonBuffer.parseObject(client.responseBody());
  if ( root["paid"] == "true" ) {
    PAID = true;
  } else {
    PAID = false;
  }
  String code = root["payment_request"];
  code.toUpperCase();
  Serial.println("HERE COMES THE BOLT11");
  Serial.println(code);  
  // Generate QRCode from Bolt11
  qrmaker( code );
  jsonBuffer.clear();
}

// QR maker function
void qrmaker(String code){

  char codeArray[code.length() + 1];
  code.toCharArray(codeArray, code.length() + 1);

  QRCode qrcode;
  uint8_t qrcodeData[qrcode_getBufferSize(11)];
  qrcode_initText(&qrcode, qrcodeData, 11, 0, codeArray );

  display.fillScreen(GxEPD_WHITE);
  // Height
  for (uint8 y = 0; y < qrcode.size; y++) {
    for (uint8 sy = 0; sy < scale; sy++) {
      // Width
      for (uint8 x = 0; x < qrcode.size; x++) {
        for (uint8 sx = 0; sx < scale; sx++) {
          if (qrcode_getModule(&qrcode, x, y)) {
            display.drawPixel( 
              border + (x * scale) + sx,
              border + (y * scale) + sy, 
              0x00 );          
          } else {          
            display.drawPixel( 
              border + (x * scale) + sx, 
              border + (y * scale) + sy, 
              0xff );          
          }
        }        
      }
    }
  }
  display.update(); 
}

  // TEST
  // The width and height of a QR Code is
  // 4 * version + 17.
  // Version 11 = 61 x 61
  // Error  Numeric   Alphanumeric    Byte
  // LOW    772       468             321
  
  // Version 40 = 177 x 177
  //    Error  Numeric   Alphanumeric Byte
  // 0  LOW    7089      4296         2953
  // 1  MEDIUM 5596      3391         2331
  // 3  HIGH   3057      1852         1273


  // Take   61 x 61 image and expand to screen
  // output 183 x 183 image
  // print each pixel 3 times 
  // print each line  3 time

  
